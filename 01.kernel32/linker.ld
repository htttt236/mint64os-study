/* 1. 출력 형식 및 아키텍처 설정 */
OUTPUT_FORMAT("elf32-i386", "elf32-i386", "elf32-i386")
OUTPUT_ARCH(i386)

SECTIONS
{
    /* ================================================== */
    /* 1. 코드 구역 (.text) - 0x10200 번지에서 강제 시작! */
    /* ================================================== */
    .text 0x10000 :
    {
        *(.text .stub .text.* .gnu.linkonce.t.*)
    } =0x90909090  /* 남는 공간은 NOP(0x90) 명령어로 채움 */

    /* 읽기 전용 데이터 (문자열 상수 등) */
    .rodata : { *(.rodata .rodata.* .gnu.linkonce.r.*) }
    .rodata1 : { *(.rodata1) }

    /* ================================================== */
    /* 2. 데이터 구역 (.data) - 디스크 섹터(512) 단위로 줄맞춤! */
    /* ================================================== */
    . = ALIGN (512);
    .data :
    {
        *(.data .data.* .gnu.linkonce.d.*)
    }
    .data1 : { *(.data1) }

    /* ================================================== */
    /* 3. 빈 공간 구역 (.bss) - 시작점과 끝점 이정표 세우기! */
    /* ================================================== */
    __bss_start = .;
    .bss :
    {
        *(.bss .bss.* .gnu.linkonce.b.*)
        *(COMMON)
        . = ALIGN(4);
    }
    _end = .; PROVIDE (end = .);

    /* ================================================== */
    /* 4. OS 개발에 필요 없는 GCC 찌꺼기 구역들 버리기 */
    /* ================================================== */
    /DISCARD/ :
    {
        *(.eh_frame)
        *(.note.gnu.build-id)
        *(.comment)
    }
}