/* 1. 출력 형식 및 아키텍처 설정 */
OUTPUT_FORMAT("elf64-x86-64", "elf64-x86-64", "elf64-x86-64")
OUTPUT_ARCH(i386:x86-64)

SECTIONS
{
    /* ================================================== */
    /* 1. 코드 구역 (.text) - 0x200000(2MB) 번지에서 강제 시작! */
    /* ================================================== */
    .text 0x200000 :
    {
        *(.text .stub .text.* .gnu.linkonce.t.*)
    } =0x90909090  /* 남는 공간은 NOP(0x90) 명령어로 채움 */

    /* 읽기 전용 데이터 (문자열 상수 등) */
    .rodata : { *(.rodata .rodata.* .gnu.linkonce.r.*) }
    .rodata1 : { *(.rodata1) }

    /* ================================================== */
    /* 2. 데이터 구역 (.data) - 시작과 끝 모두 512 단위로 정렬! */
    /* ================================================== */
    . = ALIGN (512);
    .data :
    {
        *(.data .data.* .gnu.linkonce.d.*)
        *(.data1)
        BYTE(0x00)       /* 최소 1바이트 출력 강제 */
        /* 파일 크기를 512바이트 배수로 맞추기 위한 패딩 트릭 */
        . = ALIGN (512);
    } =0x00000000

    /* ================================================== */
    /* 3. 빈 공간 구역 (.bss) - 64비트에 맞춰 8바이트 정렬! */
    /* ================================================== */
    __bss_start = .;
    .bss :
    {
        *(.bss .bss.* .gnu.linkonce.b.*)
        *(COMMON)
        . = ALIGN(8);
    }
    _end = .; PROVIDE (end = .);

    /* ================================================== */
    /* 4. OS 개발에 필요 없는 GCC 찌꺼기 구역들 버리기 */
    /* ================================================== */
    /DISCARD/ :
    {
        *(.eh_frame)
        *(.note.gnu.build-id)
        *(.comment)
    }
}